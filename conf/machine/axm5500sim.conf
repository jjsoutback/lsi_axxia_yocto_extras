## conf/machine/axm5500sim.conf
```bitbake
#@TYPE: Machine
#@NAME: axm5500sim
#@DESCRIPTION: Machine configuration for LSI AXM5500 simulator systems

PREFERRED_VERSION_linux-yocto ?= "3.4%"
PREFERRED_PROVIDER_virtual/kernel ?= "linux-yocto"

MACHINE_FEATURES += ""

MACHINE_EXTRA_RRECOMMENDS += ""

require conf/machine/include/tune-cortexa15.inc

KERNEL_IMAGETYPE = "zImage"
UBOOT_ENTRYPOINT = "0x400000"
KEEPUIMAGE = "no"

SERIAL_CONSOLE = "9600 ttyAMA0"
```
